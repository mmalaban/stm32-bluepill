## CMakeLists.txt
```
cmake_minimum_required(VERSION 3.20.0)

set(BUILD_VERSION "0.1.0")

find_package(Zephyr REQUIRED HINTS $ENV{ZEPHYR_BASE})

project(stm32-bluepill)

target_sources(app PRIVATE src/main.c src/messages.c)
```

## prj.conf
```kconfig
# General
CONFIG_MAIN_STACK_SIZE=2048
CONFIG_KERNEL_BIN_NAME="stm32-bluepill"

# GPIO for LED control
CONFIG_GPIO=y

# CAN bus
CONFIG_CAN=y

# Shell support
#CONFIG_SHELL=y
#CONFIG_SHELL_BACKEND_SERIAL=y

# Console/UART
#CONFIG_CONSOLE=y
#CONFIG_UART_CONSOLE=y
#CONFIG_SERIAL=y

# Logging (optional, useful for debugging)
# CONFIG_LOG=y
```

## boards/stm32_min_dev.overlay
```dts
/ {
	aliases {
		on-board-led = &led;
	};

	chosen {
		zephyr,canbus = &can1;
	};
};

&can1 {
	pinctrl-0 = <&can_rx_pa11 &can_tx_pa12>;
	pinctrl-names = "default";
	status = "okay";
	bus-speed = <500000>;
};
```

## src/main.c
```c
#include <zephyr/kernel.h>
#include <zephyr/drivers/gpio.h>

#include "messages.h"

#define HEARTBEAT_INTERVAL_MS 250
#define HEARTBEAT_STACK_SIZE  512
#define HEARTBEAT_PRIORITY    7  /* Preemptable priority (positive value) */

/* Onboard LED - uses the "on_board_led" alias from the DTS overlay */
static const struct gpio_dt_spec led = GPIO_DT_SPEC_GET(DT_ALIAS(on_board_led), gpios);

static void heartbeat_task(void *p1, void *p2, void *p3)
{
	ARG_UNUSED(p1);
	ARG_UNUSED(p2);
	ARG_UNUSED(p3);

	while (1) {
		gpio_pin_toggle_dt(&led);
		k_msleep(HEARTBEAT_INTERVAL_MS);
	}
}

K_THREAD_DEFINE(heartbeat_tid, HEARTBEAT_STACK_SIZE,
		heartbeat_task, NULL, NULL, NULL,
		HEARTBEAT_PRIORITY, 0, 0);

int main(void)
{
	int ret;

	if (!gpio_is_ready_dt(&led)) {
		printk("Error: LED device not ready\n");
		return -1;
	}

	ret = gpio_pin_configure_dt(&led, GPIO_OUTPUT_ACTIVE);
	if (ret < 0) {
		printk("Error: Failed to configure LED pin\n");
		return -1;
	}

	printk("Heartbeat task started (250ms interval)\n");

	ret = messages_init();
	if (ret < 0) {
		printk("Warning: CAN init failed (%d)\n", ret);
	}

	while (1) {
		k_sleep(K_FOREVER);
	}

	return 0;
}
```

## src/messages.c
```c
#include <zephyr/kernel.h>
#include <zephyr/drivers/can.h>

#include "messages.h"

#define CAN_BITRATE 500000

static const struct device *const can_dev = DEVICE_DT_GET(DT_CHOSEN(zephyr_canbus));

int messages_init(void)
{
	int ret;

	if (!device_is_ready(can_dev)) {
		printk("Error: CAN device not ready\n");
		return -ENODEV;
	}

	ret = can_set_bitrate(can_dev, CAN_BITRATE);
	if (ret < 0) {
		printk("Error: failed to set CAN bitrate (%d)\n", ret);
		return ret;
	}

	ret = can_start(can_dev);
	if (ret < 0) {
		printk("Error: failed to start CAN controller (%d)\n", ret);
		return ret;
	}

	printk("CAN bus initialized at %d bps\n", CAN_BITRATE);
	return 0;
}
```

## src/messages.h
```c
#ifndef MESSAGES_H
#define MESSAGES_H

/**
 * Initialize the CAN bus interface at 500 kbps.
 *
 * @return 0 on success, negative errno on failure.
 */
int messages_init(void);

#endif /* MESSAGES_H */
```
